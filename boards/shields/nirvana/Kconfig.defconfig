## boards/shields/nirvana/Kconfig.defconfig
```kconfig
if SHIELD_NIRVANA_LEFT

# Name must be less than 16 characters long!
config ZMK_KEYBOARD_NAME
    default "Nirvana"

config ZMK_SPLIT_ROLE_CENTRAL
    default y

config ZMK_SPLIT_BLE_CENTRAL_PERIPHERALS
  default 1

config BT_MAX_CONN
  default 6

config BT_MAX_PAIRED
  default 6

endif

if SHIELD_NIRVANA_RIGHT

config INPUT_PINNACLE
    default y

if SHIELD_NIRVANA_LEFT || SHIELD_NIRVANA_RIGHT

config ZMK_SPLIT
    default y

config ZMK_POINTING
    default y

endif

if SHIELD_NIRVANA_DONGLE

# Name must be less than 16 characters long!
config ZMK_KEYBOARD_NAME
    default "Nirvana"

config ZMK_POINTING
    default y

config ZMK_SPLIT
    default y

config ZMK_SPLIT_ROLE_CENTRAL
    default y

config ZMK_SPLIT_BLE_CENTRAL_PERIPHERALS
  default 2

config BT_MAX_CONN
  default 7

config BT_MAX_PAIRED
  default 7

endif

# ---------------------
# Kconfig for shield "nirvana_right" with board "nice_nano_v2"
# ---------------------
if BOARD_NICE_NANO_V2 && SHIELD_NIRVANA_RIGHT

config SPI
    default y

endif
```

## boards/shields/nirvana/Kconfig.shield
```kconfig
config SHIELD_NIRVANA_LEFT
    def_bool $(shields_list_contains,nirvana_left)
  
config SHIELD_NIRVANA_RIGHT
    def_bool $(shields_list_contains,nirvana_right)
  
config SHIELD_NIRVANA_DONGLE
    def_bool $(shields_list_contains,nirvana_dongle)
```

## config/west.yml
```yaml
manifest:
  defaults:
    revision: v0.3
  remotes:
    - name: zmkfirmware
      url-base: https://github.com/zmkfirmware
    - name: petejohanson
      url-base: https://github.com/petejohanson
    - name: Cris1Z
      url-base: https://github.com/Cris1Z/
    - name: halfdane
      url-base: https://github.com/halfdane/
    - name: oleksandrmaslov
      url-base: https://github.com/oleksandrmaslov/
    # Additional modules containing boards/shields/custom code can be listed here as well
    # See https://docs.zephyrproject.org/3.2.0/develop/west/manifest.html#projects
  projects:
    - name: zmk
      remote: zmkfirmware
      import: app/west.yml
      
    - name: zmk-input-gestures
      remote: Cris1Z
      revision: main

    # Add these if you want to use absolute mode:
    - name: zmk-input-processors
      remote: halfdane
      revision: main

    - name: cirque-input-module
      remote: Cris1Z
      revision: absolute_mode
  self:
    path: config
```
